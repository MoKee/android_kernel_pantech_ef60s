## arch/arm/mach-msm/cust/LCD/Kconfig
```kconfig
if CUST_PANTECH_H

###################################################
# PANTECH LCD Feature Section                     #
#                                                 #
###################################################
# * Defined LCD common feature                    # 
###################################################
config MACH_MSM8974_LCD_COMMON
	bool
	default y
	select F_SKYDISP_LCD_RESET
	select F_SKYDISP_LCD_FORCE_ONOFF        
	select F_SKYDISP_SHARPNESS_CTRL
	select F_SKYDISP_BACKLIGHT_DEBUG
	select F_SKYDISP_SILENT_BOOT
	select F_SKYDISP_CMDS_CONTROL
	select F_SKYDISP_BACKLIGHT_CMDS_CTL
	select F_QUALCOMM_DETACH_IOMMU_BUGFIX
	select F_SKYDISP_FACTORY_SLEEP_ENABLE
	select F_QUALCOMM_VIDEO_PLAYER_HALT
	select F_SKYDISP_ADJUST_MDP_BANDWIDTH
    	select F_QUALCOMM_BUGFIX_SURFACEFLINGER_PENDING	
    	select F_QUALCOMM_GPU_PATCH_FOR_BUS_HANG
	select F_QUALCOMM_GPU_PATCH_FOR_BUS_HANG_SECOND
	select F_QUALCOMM_BUGFIX_MDP_UNDERRUN
	select F_QUALCOMM_BOOTING_BLUESCREEN
	select F_QUALCOMM_MDP_RGB_LAYER_UNDERRUN
###################################################
# * Defined LCD board feature                     # 
###################################################
if MACH_MSM8974_EF56S
config DEFINE_LIST_EF56S
	bool
	default y
	select F_SKYDISP_EF56_SS
	select F_SKYDISP_CABC_CONTROL
	select F_SKYDISP_SHARPNESS_CTRL
	select F_SKYDISP_BACKLIGHT_CMDS_CTL

endif

if MACH_MSM8974_EF59S
config DEFINE_LIST_EF59S
	bool
	default y
	select F_SKYDISP_EF59_SS  
	select F_SKYDISP_CABC_CONTROL
	select F_SKYDISP_SHARPNESS_CTRL
	select F_SKYDISP_BACKLIGHT_CMDS_CTL
endif

if MACH_MSM8974_EF59K
config DEFINE_LIST_EF59K
	bool
	default y
	select F_SKYDISP_EF59_SS  
	select F_SKYDISP_CABC_CONTROL
	select F_SKYDISP_SHARPNESS_CTRL
	select F_SKYDISP_BACKLIGHT_CMDS_CTL
endif

if MACH_MSM8974_EF59L
config DEFINE_LIST_EF59L
	bool
	default y
	select F_SKYDISP_EF59_SS  
	select F_SKYDISP_CABC_CONTROL
	select F_SKYDISP_SHARPNESS_CTRL
	select F_SKYDISP_BACKLIGHT_CMDS_CTL
endif

if MACH_MSM8974_EF60S
config DEFINE_LIST_EF60S
	bool
	default y
	select F_SKYDISP_EF60_SS
	select F_SKYDISP_CABC_CONTROL
	select F_SKYDISP_SHARPNESS_CTRL
	select F_SKYDISP_BACKLIGHT_CMDS_CTL
endif

if MACH_MSM8974_EF61K
config DEFINE_LIST_EF61K
	bool
	default y
	select F_SKYDISP_EF60_SS
	select F_SKYDISP_CABC_CONTROL
	select F_SKYDISP_SHARPNESS_CTRL
	select F_SKYDISP_BACKLIGHT_CMDS_CTL
endif

if MACH_MSM8974_EF62L
config DEFINE_LIST_EF62L
	bool
	default y
	select F_SKYDISP_EF60_SS
	select F_SKYDISP_CABC_CONTROL
	select F_SKYDISP_SHARPNESS_CTRL
	select F_SKYDISP_BACKLIGHT_CMDS_CTL
endif

if MACH_MSM8974_EF63S
config DEFINE_LIST_EF63S
	bool
	default y
	select F_SKYDISP_EF63_SS
	select F_SKYDISP_HBM_FOR_AMOLED
	select F_SKYDISP_ELVSS_WORK
	select F_SKYDISP_SMARTDIMMING
endif

if MACH_MSM8974_EF63K
config DEFINE_LIST_EF63K
	bool
	default y
	select F_SKYDISP_EF63_SS
	select F_SKYDISP_HBM_FOR_AMOLED
	select F_SKYDISP_ELVSS_WORK
	select F_SKYDISP_SMARTDIMMING
endif

if MACH_MSM8974_EF63L
config DEFINE_LIST_EF63L
	bool
	default y
	select F_SKYDISP_EF63_SS
	select F_SKYDISP_HBM_FOR_AMOLED
	select F_SKYDISP_ELVSS_WORK
	select F_SKYDISP_SMARTDIMMING
endif


##############################################################
##############################################################
#               PANTECH  FEARTURE                            # 
#                                                            #
##############################################################
##############################################################      

##############################################################
# owner  : p10443          
# date    : 2013.11.26 
# PLM    : 
# Case  :       
# Description : EF56 model LCD common
##############################################################
config F_SKYDISP_EF56_SS
	bool

##############################################################
# owner  : p10443          
# date    : 2013.11.26 
# PLM    : 
# Case  :       
# Description : EF59 Series model LCD common
##############################################################
config F_SKYDISP_EF59_SS
	bool

##############################################################
# owner  : p10443          
# date    : 2013.11.26
# PLM    : 
# Case  :       
# Description : EF60/61/62 Series model LCD common
##############################################################
config F_SKYDISP_EF60_SS
	bool

##############################################################
# owner  : p10443          
# date    : 2013.11.26 
# PLM    : 
# Case  :       
# Description : EF63 Series model LCD common
##############################################################
config F_SKYDISP_EF63_SS
	bool

##############################################################
# owner  : p13832   seunghwa_ji       
# date    : 2013.04.11 
# PLM    : 
# Case  :       
# Description : it is for cabc control
##############################################################
config F_SKYDISP_CABC_CONTROL
	bool

##############################################################
# owner  : p13832 seunghwa_ji         
# date    : 2013.04.30
# PLM    : 
# Case  :       
# Description :  it's for silentboot
##############################################################
config F_SKYDISP_SILENT_BOOT
	bool

##############################################################
# owner  : p13447 shin jaegon    
# date    : 2013.05.02 
# PLM    : 
# Case  :       
# Description : Added codes for factory command ("FACTORY_SLEEP_ENABLE_I") 
##############################################################
config F_SKYDISP_FACTORY_SLEEP_ENABLE
	bool

##############################################################
# owner  : p10443          
# date    : 2013.06.27 
# PLM    : 
# Case  :       
# Description : EF56/EF59/EF60/61/62 sharpness control
##############################################################
config F_SKYDISP_SHARPNESS_CTRL
	bool

##############################################################
# owner  : p13832    
# date    : 2013.07.02 
# PLM    : 
# Case  :       
# Description : LCD cmds Test
##############################################################
config F_SKYDISP_CMDS_CONTROL
	bool

##############################################################
# owner  : p13832    
# date    : 2013.08.19 
# PLM    : 
# Case  :       
# Description : backlight on/off
##############################################################
config F_SKYDISP_BACKLIGHT_CMDS_CTL
	bool

	
##############################################################
# owner  : p13832    
# date    : 2014.01.23 
# PLM    : 
# Case  :       
# Description : oled hbm on/off
##############################################################
config F_SKYDISP_HBM_FOR_AMOLED
	bool

##############################################################
# owner  : p13832    
# date    : 2014.01.28 
# PLM    : 
# Case  :       
# Description : oled elvss porting
##############################################################
config F_SKYDISP_ELVSS_WORK
	bool

##############################################################
# owner  : p13832    
# date    : 2014.02.04 
# PLM    : 
# Case  :       
# Description : oled smart dimming
##############################################################
config F_SKYDISP_SMARTDIMMING
	bool

	
##############################################################
##############################################################
#               QUALCOMM FEARTURE                 	         # 
#							                                 #
##############################################################
##############################################################

##############################################################
# owner  : p13832    
# date    : 2014.01.08 
# PLM    : 
# Case  :       
# Description : IOMMU lock-up patch(revert patch)
##############################################################
config F_QUALCOMM_DETACH_IOMMU_BUGFIX
	bool

##############################################################
# owner  : p10443   
# date    : 2014.01.24 
# PLM    : 
# Case  : #1430521      
# Description : video player halt (1080*1920 -> 1080*607 resize play)
# TODO : official patch release check - OK (2014.01.27 official patch release)
##############################################################
config F_QUALCOMM_VIDEO_PLAYER_HALT
	bool

##############################################################
# owner  : p12226        
# date    : 2013.08.28 
# PLM    : 
# Case  :  none
# Description : mdp ab value adjusting 
##############################################################
config F_SKYDISP_ADJUST_MDP_BANDWIDTH
	bool 

##############################################################
# owner  : p10443        
# date    : 2013.11.04
# PLM    : EF60S PLM601
# Case  :  
# Description : Surfaceflinger pending cpu 90%  framework reset 			
##############################################################
config F_QUALCOMM_BUGFIX_SURFACEFLINGER_PENDING		
	bool

##############################################################
# owner  : p12452, Cho kyoungku        
# date    : 2014.01.28
# PLM    : EF61K_KK PLM154, PLM203
# Case  :  #01434521, #01433691
# Description : Watchdog reset during stability-test, cause by AHB_TIMEOUT(bus-hang)	
#			https://www.codeaurora.org/cgit/quic/la/kernel/msm/commit/?id=81dc12df9fe3d791a2228f5bdf99edba01cea036
#			https://www.codeaurora.org/cgit/quic/la/kernel/msm/commit/?id=8347e7c7297421e7e73e01a167e93335bc3e7c05
#			https://www.codeaurora.org/cgit/quic/la/kernel/msm/commit/?id=1b069a175ac8f7f86e247f88e09bb4fef5ef461f
#			https://www.codeaurora.org/cgit/quic/la/kernel/msm-3.10/commit/?h=msm-3.10&id=3fa1f13724c0af130da99348768cca46404953e7
# Related file : adreno_a3xx_snapshot.c, adreno_dispatch.c, adreno_drawctxt.c
##############################################################
config F_QUALCOMM_GPU_PATCH_FOR_BUS_HANG		
	bool	
	
##############################################################
# owner  : p16603. Kim HyunGeuk
# date    : 2014.02.10
# PLM    : EF61K_KK PLM378
# Case  :  #01438433 
# Description : Watchdog reset during stability-test, cause by AHB_TIMEOUT(bus-hang)	
#			https://www.codeaurora.org/patches/quic/la/PATCH_MSM8974_45951_IOMMU_KGSL_CLK_REFCOUNT_20140206.tar.gz 
# Related file : adreno.c, kgsl_iommu.c, kgsl_iommu.h, kgsl_mmu.h, kgsl_pwrctrl.c
##############################################################
config F_QUALCOMM_GPU_PATCH_FOR_BUS_HANG_SECOND	
	bool		

##############################################################
# owner  : p12452, Cho kyoungku        
# date    : 2014.02.24
# PLM    : EF62L_KK PLM667, PLM692
# Case  :  #01455896
# Description : Watchdog reset during stability-test, cause by XPU VIOLATION	
#			https://www.codeaurora.org/cgit/quic/la/kernel/msm/commit/?h=LNX.LA.3.5.1&id=a27f180e609abc8ee33b24325c5a191b071e1651
#			https://www.codeaurora.org/cgit/quic/la/kernel/msm/commit/?id=2241b97d7abe5d980da0560e088611611c6ed823
#			https://www.codeaurora.org/cgit/quic/la/kernel/msm-3.10/commit/?h=LNX.LA.3.8_RB1.2&id=6420b92c0e37c5782cde8381fa37dcb6cd1e2ff3
#			https://www.codeaurora.org/cgit/quic/la/kernel/msm-3.10/commit/?h=LNX.LA.3.8_RB1.2&id=5cc1d013517179198fb944c48a8d39aff3ba9297
# Related file : adreno_a3xx_snapshot.c, adreno_dispatch.c, adreno_drawctxt.c
##############################################################
config F_QUALCOMM_GPU_PATCH_FOR_PAGE_FAULT		
	bool	

##############################################################
# owner  : p16603        
# date   : 2014.02.03
# PLM    : EF61K_KK PLM146
# Case   : #01435555
# Description : Bluscreen shown in voice recoder with rotation
##############################################################
config F_QUALCOMM_BUGFIX_MDP_UNDERRUN
	bool	
	
##############################################################
# owner  : p10443        
# date   : 2014.02.17
# PLM    : 
# Case   : #01451824
# Description : The bluescreen occurs during booting in video mode.
##############################################################
config F_QUALCOMM_BOOTING_BLUESCREEN
	bool

##############################################################
# owner  : p14974
# date    : 2014.03.11
# PLM    : EF60S_KK 899
# Case  : 01465155
# Description : Fix MDP underrun over Full RGB 4 Layers
##############################################################
config F_QUALCOMM_MDP_RGB_LAYER_UNDERRUN
    bool	

endif
```
